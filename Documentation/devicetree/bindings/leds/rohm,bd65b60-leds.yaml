## Documentation/devicetree/bindings/leds/rohm,bd65b60-leds.yaml
```yaml
# SPDX-License-Identifier: GPL-2.0-only OR BSD-2-Clause
%YAML 1.2
---
$id: http://devicetree.org/schemas/leds/rohm,bd65b60-leds.yaml#
$schema: http://devicetree.org/meta-schemas/core.yaml#

title: ROHM BD65B60 device tree bindings

maintainers:
  - Bogdan Ionescu <bogdan.ionescu.work+kernel@gmail.com>

description: |
  BD65B60 is a white LED driver IC that integrates PWM
  step-up DC/DC converter with boost-capability of up to
  maximum 28.5V and current driver with drive capability of up
  to 25mA(Typ.) maximum setting. Precise brightness can be
  controlled at wide ranges through the external PWM pulse
  input.

properties:
  compatible:
    const: rohm,bd65b60

  reg:
    maxItems: 1

  led:
    type: object
    $ref: common.yaml#
    unevaluatedProperties: false

    properties:
      rohm,enable-outputs:
        description:
          Select which leds are being controlled.
          Values defined in <dt-bindings/leds/leds-bd65b60.h>
        $ref: "/schemas/types.yaml#/definitions/uint32"
        enum: [ 0, 1, 4, 5 ]

      rohm,ovp:
        description:
          Select Over-Voltage-Portection level.
          Values defined in <dt-bindings/leds/leds-bd65b60.h>
        $ref: "/schemas/types.yaml#/definitions/uint32"
        enum: [ 0, 8, 16 ]
        default: 16

    required:
      - rohm,enable-outputs

required:
  - compatible
  - reg
additionalProperties: false

examples:
  - |
    #include <dt-bindings/leds/common.h>
    #include <dt-bindings/leds/leds-bd65b60.h>

    i2c {

        led_controler@64 {
            compatible = "rohm,bd65b60";
            reg = <0x64>;

            backlight_led: led {
                function = LED_FUNCTION_BACKLIGHT;
                color = <LED_COLOR_ID_WHITE>;
                rohm,enable-outputs = <BD65B60_ENABLE_LED1>;
                default-state = "keep";
                linux,default-trigger = "backlight";
            };
        };
    };

...
```
